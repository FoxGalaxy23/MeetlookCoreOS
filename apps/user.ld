/* user.ld -- линковочный скрипт для пользовательских бинарников
 * MeetlookCoreOS.
 *
 * Результат сборки -- настоящий статический ELF64 (ET_EXEC), который
 * загрузчик ядра (kernel/loader.c, elf_load()) парсит по PT_LOAD
 * program header'ам и мапит по фиксированному окну APP_LOAD_ADDR
 * (см. include/loader.h -- значение здесь должно совпадать с ним).
 * Секция .text.entry (см. include/mlapp.h, макрос APP_ENTRY) обязана
 * оказаться первой в .text, иначе первые байты кода не будут точкой
 * входа.
 *
 * ВАЖНО (W^X, см. kernel/loader.c: elf_load()): в sandboxed-режиме
 * (обычный 'run', ring 3) загрузчик отклоняет ЛЮБОЙ PT_LOAD-сегмент,
 * который просит одновременно PF_W и PF_X -- иначе W^X-проверка не
 * значила бы ничего. GNU ld сам по себе группирует ПОСЛЕДОВАТЕЛЬНЫЕ
 * output-секции с разными флагами в ОДИН PT_LOAD, если между ними нет
 * явного разрыва по границе страницы -- т.е. без ALIGN(CONSTANT
 * (MAXPAGESIZE)) ниже .text (R+X) и .rodata/.data/.bss (R+W) слились
 * бы в один сегмент с флагами RWE, и elf_load() отклонял бы КАЖДЫЙ
 * бинарник, у которого есть хоть один байт записываемых данных (.data
 * или .bss) -- ровно то, что раньше происходило с /bin/calc (у него
 * есть статические буферы) и было бы с любым другим приложением с
 * .data/.bss. Поэтому ниже -- два ЯВНО разделённых по странице блока:
 * один только для исполняемого кода (.text/.rodata, R+X/R), другой --
 * только для записываемых данных (.data/.bss, R+W, без X). PHDRS ниже
 * говорит компоновщику держать их как два отдельных PT_LOAD с разными
 * флагами, а не пытаться их слить. */

ENTRY(app_main)
OUTPUT_FORMAT(elf64-x86-64)

APP_LOAD_ADDR = 0x02000000; /* == PROC_CODE_BASE (include/memlayout.h) == APP_LOAD_ADDR
    (include/loader.h) -- поднято в Фазе 4.4, см. подробный разбор в
    include/memlayout.h и kernel/kheap.c (стек BSP из boot.s заходил в
    старое окно [6 MiB,...), из-за чего первый же 'run'/'runc' после
    входа в shell валил систему). */
APP_MAX_SIZE  = 0x00200000; /* должно совпадать с APP_MAX_SIZE из loader.h */

PHDRS
{
    text PT_LOAD FLAGS(5); /* R+X, без W */
    data PT_LOAD FLAGS(6); /* R+W, без X */
}

SECTIONS
{
    . = APP_LOAD_ADDR;

    /* .text.entry обязана быть первой, но исполняться напрямую с
       APP_LOAD_ADDR ей не обязательно (ELF entry point берётся из
       ehdr->e_entry, а не из адреса первого байта файла) -- в отличие
       от старой flat-схемы (см. историю этого файла), где e_entry не
       существовало и точка входа была ровно первым байтом образа. */
    .text : {
        *(.text.entry)
        *(.text*)
        *(.rodata*)
    } :text

    /* Разрыв по границе страницы -- ИМЕННО он не даёт компоновщику
       слить этот сегмент с предыдущим (:text) в один RWX PT_LOAD, см.
       комментарий выше. */
    . = ALIGN(CONSTANT(MAXPAGESIZE));

    .data : {
        /* Гарантирует, что .data никогда не окажется ПОЛНОСТЬЮ пустой
           секцией: если у приложения нет ни одной *(.data*) входной
           секции (например, apps/hello.c -- там только строковые
           константы, они уже ушли в .rodata внутри :text выше), GNU ld
           тихо выбрасывает пустую .data целиком -- а вместе с ней и её
           адрес, так что второй PT_LOAD (:data) остался бы с vaddr=0 и
           elf_load() отклонял бы такой (на самом деле совершенно
           безобидный) бинарник, посчитав его выходящим за пределы окна
           процесса (см. include/memlayout.h: окно начинается с
           PROC_CODE_BASE = 0x02000000, а не с 0). Восемь лишних нулевых
           байт с запасом отбивают эту деградацию, ничего не стоя
           приложениям, у которых .data и так не пуста. */
        QUAD(0);
        *(.data*)
    } :data

    .bss (NOLOAD) : {
        *(COMMON)
        *(.bss*)
    } :data

    /* Notes ELF-заголовков (.note.gnu.property и т.п.) компилятор
       добавляет сам -- нам они не нужны в PT_LOAD рантайма приложения
       (это просто метаданные для линковщика/инструментов), поэтому
       выбрасываем, чтобы не путать elf_load() лишними program header'ами. */
    /DISCARD/ : { *(.note.*) *(.eh_frame*) *(.comment) }

    app_end = .;
}

ASSERT(app_end - APP_LOAD_ADDR <= APP_MAX_SIZE,
       "user binary (code+data+bss) exceeds APP_MAX_SIZE -- см. include/loader.h")
